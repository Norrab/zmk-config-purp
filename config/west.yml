## config/west.yml
```yaml
manifest:
  defaults:
    revision: v0.3
  remotes:
    - name: zmkfirmware
      url-base: https://github.com/zmkfirmware
    # Additional modules containing boards/shields/custom code can be listed here as well
    # See https://docs.zephyrproject.org/3.2.0/develop/west/manifest.html#projects
    # support nice_oled and nice_epaper
    - name: mctechnology17
      url-base: https://github.com/mctechnology17
    - name: badjeff
      url_base: https://github.com/badjeff
  projects:
    - name: zmk
      remote: zmkfirmware
      import: app/west.yml
    # support nice_oled and nice_epaper
    - name: zmk-nice-oled
      remote: mctechnology17
      revision: main
    # TrackPoint support
    - name: kb_zmk_ps2_mouse_trackpoint_driver
      remote: badjeff
      revision: main
  self:
    path: config
```
